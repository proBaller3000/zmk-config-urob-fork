/*
 * Copyright (c) 2020 The ZMK Contributors
 *
 * SPDX-License-Identifier: MIT
 */

#include <behaviors.dtsi>
#include <dt-bindings/zmk/keys.h>
#include <dt-bindings/zmk/bt.h>
#include <dt-bindings/zmk/outputs.h>
#include <dt-bindings/zmk/ext_power.h>
#include <dt-bindings/led/led.h>
#include <dt-bindings/zmk/backlight.h>
#include <dt-bindings/zmk/rgb.h>
#include <dt-bindings/zmk/reset.h>

#include "helper.h"
#include "mouse.dtsi"
#include "symbols.h"

#define rfu &none

#define DEF 0
#define NAV 1
#define NUM 2
#define MOU 3
#define LK 4
#define SYM 5
#define UML 6
#define SYS 7

&caps_word {
    continue-list = <UNDERSCORE MINUS FSLH LS(FSLH)>;
};

ZMK_BEHAVIOR(endsemi, macro,
    wait-ms = <30>;
    tap-ms = <10>;
    bindings = <&macro_tap &kp END>
             , <&macro_tap &kp LS(COMMA)>;
)

ZMK_BEHAVIOR(lk_n, macro,
    wait-ms = <5>;
    tap-ms = <5>;
    bindings = <&macro_tap &kp LC(B)>
             , <&macro_tap &kp N>;
)
ZMK_BEHAVIOR(lk_p, macro,
    wait-ms = <5>;
    tap-ms = <5>;
    bindings = <&macro_tap &kp LC(B)>
             , <&macro_tap &kp P>;
)
ZMK_BEHAVIOR(lk_d, macro,
    wait-ms = <5>;
    tap-ms = <5>;
    bindings = <&macro_tap &kp LC(B)>
             , <&macro_tap &kp AMPS>;
)
ZMK_BEHAVIOR(lk_c, macro,
    wait-ms = <5>;
    tap-ms = <5>;
    bindings = <&macro_tap &kp LC(B)>
             , <&macro_tap &kp C>;
)
ZMK_BEHAVIOR(lk_x, macro,
    wait-ms = <5>;
    tap-ms = <5>;
    bindings = <&macro_tap &kp LC(B)>
             , <&macro_tap &kp X>;
)
ZMK_BEHAVIOR(lk_v, macro,
    wait-ms = <5>;
    tap-ms = <5>;
    bindings = <&macro_tap &kp LC(B)>
             , <&macro_tap &kp V>;
)
ZMK_BEHAVIOR(lk_b, macro,
    wait-ms = <5>;
    tap-ms = <5>;
    bindings = <&macro_tap &kp LC(B)>
             , <&macro_tap &kp B>;
)
ZMK_BEHAVIOR(lk_w, macro,
    wait-ms = <5>;
    tap-ms = <5>;
    bindings = <&macro_tap &kp LC(B)>
             , <&macro_tap &kp W>;
)
ZMK_BEHAVIOR(lk_r, macro,
    wait-ms = <5>;
    tap-ms = <5>;
    bindings = <&macro_tap &kp LC(B)>
             , <&macro_tap &kp R>;
)
ZMK_BEHAVIOR(lk_z, macro,
    wait-ms = <5>;
    tap-ms = <5>;
    bindings = <&macro_tap &kp LC(B)>
             , <&macro_tap &kp Y>;
)
ZMK_BEHAVIOR(lk_g, macro,
    wait-ms = <5>;
    tap-ms = <5>;
    bindings = <&macro_tap &kp LC(B)>
             , <&macro_tap &kp G>;
)
ZMK_BEHAVIOR(lk_e, macro,
    wait-ms = <5>;
    tap-ms = <5>;
    bindings = <&macro_tap &kp LC(B)>
             , <&macro_tap &kp E>;
)
ZMK_BEHAVIOR(lk_q, macro,
    wait-ms = <5>;
    tap-ms = <5>;
    bindings = <&macro_tap &kp LC(B)>
             , <&macro_tap &kp Q>;
)
ZMK_BEHAVIOR(lk_sn, macro,
    wait-ms = <5>;
    tap-ms = <5>;
    bindings = <&macro_tap &kp LC(B)>
             , <&macro_tap &kp LS(N)>;
)
ZMK_BEHAVIOR(lk_sr, macro,
    wait-ms = <5>;
    tap-ms = <5>;
    bindings = <&macro_tap &kp LC(B)>
             , <&macro_tap &kp LS(R)>;
)
ZMK_BEHAVIOR(lk_st, macro,
    wait-ms = <5>;
    tap-ms = <5>;
    bindings = <&macro_tap &kp LC(B)>
             , <&macro_tap &kp LS(T)>;
)
ZMK_BEHAVIOR(lk_minus, macro,
    wait-ms = <5>;
    tap-ms = <5>;
    bindings = <&macro_tap &kp LC(B)>
             , <&macro_tap &kp DE_MIN>;
)
ZMK_BEHAVIOR(lk_lbkt, macro,
    wait-ms = <5>;
    tap-ms = <5>;
    bindings = <&macro_tap &kp LC(B)>
             , <&macro_tap &kp LBRACKET>;
)

ZMK_BEHAVIOR(swapper3, macro,
    wait-ms = <30>;
    tap-ms = <10>;
    bindings = <&macro_press &mo NAV &kp LALT>
             , <&macro_tap &kp TAB>
             , <&macro_pause_for_release>
             , <&macro_release &mo NAV &kp LALT>;
)

ZMK_BEHAVIOR(swapper4, macro,
    wait-ms = <30>;
    tap-ms = <10>;
    bindings = <&macro_press &mo NAV &kp LCTRL>
             , <&macro_tap &kp TAB>
             , <&macro_pause_for_release>
             , <&macro_release &mo NAV &kp LCTRL>;
)

ZMK_BEHAVIOR(htap, hold_tap,
    flavor = "balanced";
    tapping-term-ms = <200>;
    quick-tap-ms = <175>;
    bindings = <&kp>, <&kp>;
)

ZMK_BEHAVIOR(hrm, hold_tap,
    flavor = "balanced";
    tapping-term-ms = <280>;
    quick-tap-ms = <175>;
    bindings = <&kp>, <&kp>;
    hold-while-undecided;
)

ZMK_BEHAVIOR(lclsht, hold_tap,
   flavor = "tap-preferred";
   tapping-term-ms = <280>;
   quick-tap-ms = <175>;
   bindings = <&sk>, <&kp>;
)

ZMK_BEHAVIOR(hrsl, hold_tap,
    flavor = "balanced";
    tapping-term-ms = <280>;
    quick-tap-ms = <175>;
    bindings = <&kp>, <&sl>;
    hold-while-undecided;
)

ZMK_BEHAVIOR(ltmorph, hold_tap,
    flavor = "balanced";
    tapping-term-ms = <280>;
    quick-tap-ms = <175>;
    bindings = <&layer_sft>, <&kp>;
)

ZMK_BEHAVIOR(srm, hold_tap,
    flavor = "balanced";
    tapping-term-ms = <250>;
    quick-tap-ms = <175>;
    bindings = <&kp>, <&sk>;
)

ZMK_BEHAVIOR(hpr, hold_tap,
    flavor = "balanced";
    tapping-term-ms = <280>;
    quick-tap-ms = <175>;
    bindings = <&kp>, <&smart_bspc>;
    hold-while-undecided;
)

ZMK_BEHAVIOR(lm, hold_tap,
    flavor = "tap-preferred";
    tapping-term-ms = <280>;
    quick-tap-ms = <175>;
    bindings = <&kp>, <&kp>;
    require-prior-idle-ms = <350>;
)

ZMK_BEHAVIOR(ht, hold_tap,
    flavor = "tap-preferred";
    tapping-term-ms = <280>;
    quick-tap-ms = <175>;
    bindings = <&kp>, <&kp>;
    require-prior-idle-ms = <250>;
)

ZMK_BEHAVIOR(ltsk, hold_tap,
    flavor = "tap-preferred";
    tapping-term-ms = <280>;
    quick-tap-ms = <175>;
    bindings = <&mo>, <&sk>;
)

ZMK_BEHAVIOR(kpsl, hold_tap,
    flavor = "tap-preferred";
    tapping-term-ms = <280>;
    quick-tap-ms = <175>;
    bindings = <&kp>, <&sl>;
)

ZMK_BEHAVIOR(ltsl, hold_tap,
    flavor = "balanced";
    tapping-term-ms = <280>;
    quick-tap-ms = <175>;
    bindings = <&mo>, <&sl>;
)

ZMK_BEHAVIOR(tm, hold_tap,
    flavor = "tap-preferred";
    tapping-term-ms = <280>;
    quick-tap-ms = <175>;
    bindings = <&kp>, <&to>;
    hold-while-undecided;
)

ZMK_BEHAVIOR(atm, hold_tap,
    flavor = "tap-preferred";
    tapping-term-ms = <250>;
    quick-tap-ms = <175>;
    bindings = <&kp>, <&to>;
)

ZMK_BEHAVIOR(ltm, hold_tap,
    flavor = "tap-preferred";
    tapping-term-ms = <280>;
    quick-tap-ms = <175>;
    bindings = <&mo>, <&to>;
)

ZMK_BEHAVIOR(lms, hold_tap,
    flavor = "tap-preferred";
    tapping-term-ms = <280>;
    quick-tap-ms = <175>;
    bindings = <&swapper3>, <&kp>;
)

ZMK_BEHAVIOR(rms, hold_tap,
    flavor = "tap-preferred";
    tapping-term-ms = <280>;
    quick-tap-ms = <175>;
    bindings = <&key_repeat>, <&kp>;
)
#define ARROWKEYS LM1 LM2 LM3 LT2

// Alt+Tab swapper, requires PR #1366
ZMK_BEHAVIOR(swapper, tri_state,
    bindings = <&kt LALT>, <&kp TAB>, <&kt LALT>;
    ignored-key-positions = <ARROWKEYS>;
)
ZMK_BEHAVIOR(swapper2, tri_state,
    bindings = <&kt LCTRL>, <&kp TAB>, <&kt LCTRL>;
    ignored-key-positions = <ARROWKEYS>;
)

// Custom Combos
#undef COMBO_TERM
#define COMBO_TERM 40

// use require-prior-idle-ms for combos
//#undef COMBO_HOOK
//#define COMBO_HOOK require-prior-idle-ms = <280>;

#define ______ &trans
#define HT(key) &lm LC(key) key

ZMK_BEHAVIOR(smart_bspc, mod_morph,
    bindings = <&kp BSPC>, <&kp DEL>;
    mods = <(MOD_LSFT)>;
)

// reuse basic mod-morph scheme
#define SIMPLE_MORPH(NAME, MOD, BINDING1, BINDING2) \
    ZMK_BEHAVIOR(NAME, mod_morph, \
        mods = <(MOD_L ## MOD|MOD_R ## MOD)>; \
        bindings = <BINDING1>, <BINDING2>; \
    )

SIMPLE_MORPH(layer_sft, SFT, &mo NAV, &mo MOU)

ZMK_COMBO(sys_layer_right, &mo SYS, RH1 RH0, ALL)
ZMK_COMBO(sys_layer_left, &mo SYS, LH1 LH0, ALL)

&sk {
    release-after-ms = <3000>;
};

/ {
    behaviors {
      skq: sticky_key_lazy {
        label = "sticky lazy";
        compatible = "zmk,behavior-sticky-key";
        #binding-cells = <1>;
        bindings = <&kp>;
        release-after-ms = <3000>;
        // lazy; this setting seems to not (yet) work for my pipeline
        ignore-modifiers;
      };
    };
};

ZMK_BEHAVIOR(skm, hold_tap,
    flavor = "balanced";
    tapping-term-ms = <200>;
    quick-tap-ms = <175>;
    bindings = <&skq>, <&kp>;
)

ZMK_BEHAVIOR(skml, hold_tap,
    flavor = "balanced";
    tapping-term-ms = <200>;
    quick-tap-ms = <175>;
    bindings = <&sk>, <&kp>;
)

ZMK_BEHAVIOR(umlbsp, hold_tap,
    flavor = "balanced";
    tapping-term-ms = <200>;
    quick-tap-ms = <175>;
    bindings = <&mo>, <&smart_bspc>;
)

ZMK_LAYER(default_layer,
  // ╭─────────────┬─────────────┬─────────────┬─────────────┬─────────────╮   ╭─────────────┬─────────────┬─────────────┬─────────────┬─────────────╮
XXX    &kp Q         &lms 0 W         &lt LK E   &lt UML R     &htap LC(B) T     &kp Y         &kp U         &kp I         &kp O         &kp P        XXX
  // ├─────────────┼─────────────┼─────────────┼─────────────┼─────────────┤   ├─────────────┼─────────────┼─────────────┼─────────────┼─────────────┤
XXX    &skm LSHFT A  &skm LALT S   &skm LCTRL D  &skm LGUI F   &kp G             &kp H         &kp J         &kp K         &kp L       &skm RSHFT DE_MIN XXX
  // ├─────────────┼─────────────┼─────────────┼─────────────┼─────────────┤   ├─────────────┼─────────────┼─────────────┼─────────────┼─────────────┤
XXX    &kp Z         &kp X         &kp C     &lclsht LC(LSHFT) V &kp B           &kp N   &lclsht RC(RSHFT) M &kp COMMA     &kp DOT  &skm RCTRL ESC    XXX
  // ╰─────────────┼─────────────┼─────────────┼─────────────┼─────────────┤   ├─────────────┼─────────────┼─────────────┼─────────────┼─────────────╯
XXX                                            &lt NUM TAB &ltmorph 0 SPACE     &lt SYM RET   &smart_bspc   XXX
  //                                           ╰─────────────┴─────────────╯   ╰─────────────┴─────────────╯
)
ZMK_LAYER(nav_layer,
  // ╭─────────────┬─────────────┬─────────────┬─────────────┬─────────────╮   ╭─────────────┬─────────────┬─────────────┬─────────────┬─────────────╮
XXX    &lk_q         &lk_w         &lk_e         &lk_r         &lk_st             &lk_z         &kp PG_UP     U_WH_U        &kp PG_DN     &lk_p        XXX
  // ├─────────────┼─────────────┼─────────────┼─────────────┼─────────────┤   ├─────────────┼─────────────┼─────────────┼─────────────┼─────────────┤
XXX    &sk LSHFT     &sk LALT      &sk LCTRL     &sk LGUI      &lk_g             &kp LEFT      &kp DOWN      &kp UP        &kp RIGHT     &lk_minus    XXX
  // ├─────────────┼─────────────┼─────────────┼─────────────┼─────────────┤   ├─────────────┼─────────────┼─────────────┼─────────────┼─────────────┤
XXX    ______        &lk_x         &lk_c         &lk_v         &lk_b            &lk_n &lclsht RC(RSHFT) HOME  U_WH_D       &kp END       &lk_lbkt     XXX
  // ╰─────────────┼─────────────┼─────────────┼─────────────┼─────────────┤   ├─────────────┼─────────────┼─────────────┼─────────────┼─────────────╯
XXX                                              ______        &ltm NAV DEF      &lk_sn        &lk_sr                                                 XXX
  //                                           ╰─────────────┴─────────────╯   ╰─────────────┴─────────────╯
)

ZMK_LAYER(numbers_layer,
  // ╭─────────────┬─────────────┬─────────────┬─────────────┬─────────────╮   ╭─────────────┬─────────────┬─────────────┬─────────────┬─────────────╮
XXX    ______        HT(F7)        HT(F8)        HT(F9)        HT(F12)           ______        HT(N7)        HT(N8)        HT(N9)        &kp COMMA    XXX
  // ├─────────────┼─────────────┼─────────────┼─────────────┼─────────────┤   ├─────────────┼─────────────┼─────────────┼─────────────┼─────────────┤
XXX    ______        &skm LALT F4 &skm LCTRL F5  &skm LGUI F6  HT(F11)           HT(N0)        &kp N4        &kp N5        &kp N6        ______       XXX
  // ├─────────────┼─────────────┼─────────────┼─────────────┼─────────────┤   ├─────────────┼─────────────┼─────────────┼─────────────┼─────────────┤
XXX    ______        &kp F1        &kp F2  &lclsht RC(RSHFT) F3  HT(F10)        ______  &lclsht RC(RSHFT) N1 &kp N2        &kp N3       &skm RCTRL DOT XXX
  // ╰─────────────┼─────────────┼─────────────┼─────────────┼─────────────┤   ├─────────────┼─────────────┼─────────────┼─────────────┼─────────────╯
XXX                                              ______        &ltm NAV DEF     ______         ______                                                 XXX
  //                                           ╰─────────────┴─────────────╯   ╰─────────────┴─────────────╯
)

ZMK_LAYER(mouse_layer,
  // ╭─────────────┬─────────────┬─────────────┬─────────────┬─────────────╮   ╭─────────────┬─────────────┬─────────────┬─────────────┬─────────────╮
XXX   U_WH_U        U_WH_L        U_MS_U        U_WH_R        ______            ______         U_WH_L         rfu          U_WH_R        U_WH_U       XXX
  // ├─────────────┼─────────────┼─────────────┼─────────────┼─────────────┤   ├─────────────┼─────────────┼─────────────┼─────────────┼─────────────┤
XXX   ______        U_MS_L        U_MS_D        U_MS_R        &kp LGUI           U_MS_L        U_MS_D         U_MS_U       U_MS_R        ______       XXX
  // ├─────────────┼─────────────┼─────────────┼─────────────┼─────────────┤   ├─────────────┼─────────────┼─────────────┼─────────────┼─────────────┤
XXX   U_WH_D        U_BTN3        U_BTN2        U_BTN1        &swapper3         &swapper3        U_BTN1        U_BTN2         U_BTN3       U_WH_D     XXX
  // ╰─────────────┼─────────────┼─────────────┼─────────────┼─────────────┤   ├─────────────┼─────────────┼─────────────┼─────────────┼─────────────╯
XXX                                              ______        &ltm NAV DEF     ______         ______                                                 XXX
  //                                           ╰─────────────┴─────────────╯   ╰─────────────┴─────────────╯
)

ZMK_LAYER(leader_key_layer,
  // ╭─────────────┬─────────────┬─────────────┬─────────────┬─────────────╮   ╭─────────────┬─────────────┬─────────────┬─────────────┬─────────────╮
XXX    rfu           rfu           rfu           rfu           rfu           &kp C_VOLUME_DOWN &kp C_PREVIOUS &kp C_PLAY_PAUSE &kp C_NEXT &kp C_VOLUME_UP XXX
  // ├─────────────┼─────────────┼─────────────┼─────────────┼─────────────┤   ├─────────────┼─────────────┼─────────────┼─────────────┼─────────────┤
XXX    rfu           rfu           rfu           rfu           rfu              &kp LBRACKET  &kp DE_LPRN   &kp DE_RPRN   &kp RBRACKET    rfu         XXX
  // ├─────────────┼─────────────┼─────────────┼─────────────┼─────────────┤   ├─────────────┼─────────────┼─────────────┼─────────────┼─────────────┤
XXX    rfu           rfu           rfu           rfu           rfu               &kp DE_LN_LABK &kp LBRACE    &kp RBRACE    &kp DE_LN_RABK  rfu       XXX
  // ╰─────────────┼─────────────┼─────────────┼─────────────┼─────────────┤   ├─────────────┼─────────────┼─────────────┼─────────────┼─────────────╯
XXX                                              rfu           rfu               ______        ______                                               XXX
  //                                           ╰─────────────┴─────────────╯   ╰─────────────┴─────────────╯
)

ZMK_LAYER(symbols_layer,
  // ╭─────────────┬─────────────┬─────────────┬─────────────┬─────────────╮   ╭─────────────┬─────────────┬─────────────┬─────────────┬─────────────╮
XXX    &kp DE_QUES   &kp DE_AT     &kp DE_EQL   rfu           rfu              rfu           rfu           rfu           &kp DE_PIPE      &kp DE_PERC    XXX
  // ├─────────────┼─────────────┼─────────────┼─────────────┼─────────────┤   ├─────────────┼─────────────┼─────────────┼─────────────┼─────────────┤
XXX    &skm LSHFT DE_AMPS &skm LALT DE_SQT &skm LCTRL DE_DQT &skm LGUI DE_FSLH &kp DE_GRAVE &kp DE_HASH &kp DE_TILD rfu &kp DE_DLLR &hrm RSHFT DE_PLUS XXX
  // ├─────────────┼─────────────┼─────────────┼─────────────┼─────────────┤   ├─────────────┼─────────────┼─────────────┼─────────────┼─────────────┤
XXX    rfu           &kp DE_ASTR   &caps_word   &kp DE_LABK   &kp DE_BSLH         &kp DE_EXCL   rfu       &endsemi      rfu      &skm RCTRL LA(F4) XXX
  // ╰─────────────┼─────────────┼─────────────┼─────────────┼─────────────┤   ├─────────────┼─────────────┼─────────────┼─────────────┼─────────────╯
XXX                                              ______        ______            ______        ______                                                 XXX
  //                                           ╰─────────────┴─────────────╯   ╰─────────────┴─────────────╯
)

ZMK_LAYER(umlaut,
  // ╭─────────────┬─────────────┬─────────────┬─────────────┬─────────────╮   ╭─────────────┬─────────────┬─────────────┬─────────────┬─────────────╮
XXX    rfu           rfu           rfu           rfu           rfu               &kp DE_SZ     &kp DE_UE     rfu           &kp DE_OE     rfu          XXX
  // ├─────────────┼─────────────┼─────────────┼─────────────┼─────────────┤   ├─────────────┼─────────────┼─────────────┼─────────────┼─────────────┤
XXX    &kp DE_AE     rfu           rfu           rfu           rfu               rfu           rfu           rfu           rfu           rfu          XXX
  // ├─────────────┼─────────────┼─────────────┼─────────────┼─────────────┤   ├─────────────┼─────────────┼─────────────┼─────────────┼─────────────┤
XXX    rfu           rfu           rfu           rfu           rfu               rfu           rfu           rfu           rfu           rfu          XXX
  // ╰─────────────┼─────────────┼─────────────┼─────────────┼─────────────┤   ├─────────────┼─────────────┼─────────────┼─────────────┼─────────────╯
XXX                                              rfu           rfu               rfu           rfu                                                    XXX
  //                                           ╰─────────────┴─────────────╯   ╰─────────────┴─────────────╯
)

ZMK_LAYER(system_layer,
  // ╭─────────────┬─────────────┬─────────────┬─────────────┬─────────────╮                              ╭─────────────┬─────────────┬─────────────┬─────────────┬─────────────╮
XXX    &bootloader   &bt BT_CLR    &bt BT_NXT    &rgb_ug RGB_HUD &rgb_ug RGB_COLOR_HSB(128,100,100)         &ext_power EP_ON &ext_power EP_OFF ______  ______      &bootloader    XXX
  // ├─────────────┼─────────────┼─────────────┼─────────────┼─────────────┤                              ├─────────────┼─────────────┼─────────────┼─────────────┼─────────────┤
XXX    &rgb_ug RGB_TOG &rgb_ug RGB_EFF &rgb_ug RGB_EFR &rgb_ug RGB_BRI &rgb_ug RGB_BRD                   &bt BT_SEL 0  &bt BT_SEL 1  &bt BT_SEL 2  &bt BT_SEL 3  &bt BT_SEL 4     XXX
  // ├─────────────┼─────────────┼─────────────┼─────────────┼─────────────┤                              ├─────────────┼─────────────┼─────────────┼─────────────┼─────────────┤
XXX    &rgb_ug RGB_SPI &rgb_ug RGB_SPD &rgb_ug RGB_SAI &rgb_ug RGB_SAD &rgb_ug RGB_HUI                      ______        ______        ______        ______        ______        XXX
  // ╰─────────────┼─────────────┼─────────────┼─────────────┼─────────────┤                              ├─────────────┼─────────────┼─────────────┼─────────────┼─────────────╯
XXX                                               ______        ______                                       ______        ______                                                 XXX
  //                                           ╰─────────────┴─────────────╯                              ╰─────────────┴─────────────╯
)

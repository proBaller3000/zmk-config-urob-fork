## config/west.yml
```yaml
manifest:
  remotes:
    - name: zmkfirmware
      url-base: https://github.com/zmkfirmware
    - name: proBaller3000
      url-base: https://github.com/proBaller3000
  projects:
    - name: zmk
      remote: proBaller3000
      revision: main
      import: app/west.yml
  self:
    path: config
```
